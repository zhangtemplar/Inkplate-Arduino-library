/**
 **************************************************
 * @file        Inkplate13SPECTRA_Digital_Picture_Frame.ino
 * @brief       SD and web-synced digital picture frame for Inkplate 13SPECTRA.
 *
 * @details     Shows photos from an SD card, downloads photos listed in a web
 *              Google Drive folder manifest to the SD card, serves a USB/config-mode web UI, and
 *              supports a pre-rasterized .bin format generated by the companion
 *              Python converter in tools/.
 **************************************************/

#ifndef ARDUINO_INKPLATE13SPECTRA
#error "Wrong board selection for this example, please select Soldered Inkplate 13SPECTRA."
#endif

#include <ArduinoJson.h>
#include <HTTPClient.h>
#include <Inkplate.h>
#include <WebServer.h>
#include <WiFi.h>
#include "esp_sleep.h"

// Set this to a VBUS/USB-power detect GPIO if your hardware exposes one.
// With the default -1, config mode starts on first boot or when /frame/config_mode.txt exists.
#define USB_POWER_DETECT_PIN -1
#define USB_POWER_ACTIVE_LEVEL HIGH
#define WAKE_BUTTON_PIN GPIO_NUM_18
#define WAKE_BUTTON_ACTIVE_LEVEL LOW
#define WAKE_BUTTON_DEBOUNCE_MS 60

static const char *CONFIG_PATH = "/frame/config.json";
static const char *SYNC_STATE_PATH = "/frame/sync_state.json";
static const char *CONFIG_TRIGGER_PATH = "/frame/config_mode.txt";
static const char *DEBUG_LOG_PATH = "/frame/sync_debug.log";
static const char *MANIFEST_RESPONSE_PATH = "/frame/last_manifest_response.txt";
static const char *DEFAULT_PHOTO_DIR = "/frame/photos";
static const char *AP_SSID = "Inkplate13Frame";
static const char *AP_PASSWORD = "inkplate13";
static const char *FRAME_BUILD_ID = "sync-debug-2026-10-19-5";

static const uint16_t MAX_PHOTOS = 128;
static const uint8_t MAX_MANIFEST_ITEMS = 48;
static const size_t MANIFEST_JSON_CAPACITY = 65536;
static const size_t MAX_MANIFEST_BODY_BYTES = 60000;
static const size_t MAX_DEBUG_LOG_BYTES = 24000;
static const size_t WEB_DEBUG_PREVIEW_BYTES = 4000;
static const uint32_t WIFI_TIMEOUT_MS = 20000;
static const int32_t HTTP_CONNECT_TIMEOUT_MS = 20000;
static const uint16_t HTTP_READ_TIMEOUT_MS = 60000;
static const uint32_t DOWNLOAD_IDLE_TIMEOUT_MS = 15000;
static const uint8_t PHOTO_ROTATION_PORTRAIT = 0;
static const uint8_t PHOTO_ROTATION_LANDSCAPE = 1;

Inkplate display;
WebServer server(80);
RTC_DATA_ATTR uint32_t updatesSinceLastSync = 0;
RTC_DATA_ATTR bool syncCounterInitialized = false;

struct FrameConfig
{
    char wifiSsid[64];
    char wifiPassword[64];
    char scriptUrl[256];
    char syncToken[96];
    char photoDir[96];
    bool shuffle;
    uint32_t updateMinutes;
    uint16_t syncEveryUpdates;
    float lowBatteryVoltage;
    uint32_t lastIndex;
};

struct ImageDimensions
{
    uint16_t width;
    uint16_t height;
    bool valid;
};

FrameConfig config;
String photoList[MAX_PHOTOS];
uint16_t photoCount = 0;
String lastWebMessage;
SdFile uploadFile;
String uploadFinalPath;
String uploadTempPath;
String uploadResultMessage;
String lastDownloadError;
bool uploadOk = false;
bool configReconnectPending = false;
uint32_t configReconnectAt = 0;
bool configApRunning = false;
bool configModeRunning = false;
bool configSyncPending = false;
bool syncInProgress = false;
uint32_t lastLongTaskWebService = 0;

static const uint8_t BIN_MAGIC[8] = {'I', 'P', '1', '3', 'S', 'P', '6', 'B'};
static const char *HTTP_DEBUG_HEADER_KEYS[] = {"Content-Type", "Content-Length", "Location", "Transfer-Encoding"};

void copyString(char *dst, const char *src, size_t size)
{
    if (size == 0)
        return;
    strncpy(dst, src ? src : "", size - 1);
    dst[size - 1] = '\0';
}

uint16_t readLe16(const uint8_t *p)
{
    return (uint16_t)p[0] | ((uint16_t)p[1] << 8);
}

uint32_t readLe32(const uint8_t *p)
{
    return (uint32_t)p[0] | ((uint32_t)p[1] << 8) | ((uint32_t)p[2] << 16) | ((uint32_t)p[3] << 24);
}

uint16_t readBe16(const uint8_t *p)
{
    return ((uint16_t)p[0] << 8) | (uint16_t)p[1];
}

uint32_t readBe32(const uint8_t *p)
{
    return ((uint32_t)p[0] << 24) | ((uint32_t)p[1] << 16) | ((uint32_t)p[2] << 8) | (uint32_t)p[3];
}

bool readByte(SdFile &file, uint8_t &value)
{
    return file.read(&value, 1) == 1;
}

bool readBe16(SdFile &file, uint16_t &value)
{
    uint8_t bytes[2];
    if (file.read(bytes, sizeof(bytes)) != (int)sizeof(bytes))
        return false;
    value = readBe16(bytes);
    return true;
}

void setDefaultConfig()
{
    memset(&config, 0, sizeof(config));
    copyString(config.photoDir, DEFAULT_PHOTO_DIR, sizeof(config.photoDir));
    config.shuffle = true;
    config.updateMinutes = 60;
    config.syncEveryUpdates = 24;
    config.lowBatteryVoltage = 3.45f;
    config.lastIndex = 0;
}

void normalizePhotoDir()
{
    String path = config.photoDir;
    path.trim();
    if (path.length() == 0)
        path = DEFAULT_PHOTO_DIR;
    if (!path.startsWith("/"))
        path = "/" + path;
    while (path.length() > 1 && path.endsWith("/"))
        path.remove(path.length() - 1);
    copyString(config.photoDir, path.c_str(), sizeof(config.photoDir));
}

void ensureStorage()
{
    SdFat &sd = display.getSdFat();
    sd.mkdir("/frame", true);
    normalizePhotoDir();
    sd.mkdir(config.photoDir, true);
}

String redactUrlToken(String url)
{
    int tokenStart = url.indexOf("token=");
    if (tokenStart < 0)
        return url;

    int valueStart = tokenStart + 6;
    int valueEnd = url.indexOf('&', valueStart);
    if (valueEnd < 0)
        valueEnd = url.length();
    return url.substring(0, valueStart) + "REDACTED" + url.substring(valueEnd);
}

void debugLog(const String &message)
{
    String line = String(millis()) + " " + message;
    Serial.println(line);

    SdFat &sd = display.getSdFat();
    sd.mkdir("/frame", true);

    SdFile existing;
    if (existing.open(DEBUG_LOG_PATH, O_RDONLY))
    {
        uint32_t size = existing.fileSize();
        existing.close();
        if (size > MAX_DEBUG_LOG_BYTES)
            sd.remove(DEBUG_LOG_PATH);
    }

    SdFile logFile;
    if (logFile.open(DEBUG_LOG_PATH, O_WRONLY | O_CREAT | O_APPEND))
    {
        logFile.println(line);
        logFile.close();
    }
}

void setDownloadError(const String &message)
{
    lastDownloadError = message;
    debugLog(message);
}

bool writeTextFile(const char *path, const String &body)
{
    SdFat &sd = display.getSdFat();
    sd.remove(path);

    SdFile file;
    if (!file.open(path, O_WRONLY | O_CREAT | O_TRUNC))
        return false;
    file.print(body);
    file.close();
    return true;
}

String readTextFileTail(const char *path, size_t maxBytes)
{
    SdFile file;
    if (!file.open(path, O_RDONLY))
        return "";

    uint32_t size = file.fileSize();
    if (size > maxBytes)
        file.seekSet(size - maxBytes);

    String out;
    char buffer[129];
    while (file.available() && out.length() < maxBytes)
    {
        int toRead = min((int)sizeof(buffer) - 1, (int)(maxBytes - out.length()));
        int got = file.read(buffer, toRead);
        if (got <= 0)
            break;
        buffer[got] = '\0';
        out += buffer;
    }

    file.close();
    return out;
}

bool loadConfig()
{
    setDefaultConfig();

    SdFile file;
    if (!file.open(CONFIG_PATH, O_RDONLY))
        return false;

    size_t len = file.fileSize();
    if (len == 0 || len > 4096)
    {
        file.close();
        return false;
    }

    char *json = (char *)malloc(len + 1);
    if (!json)
    {
        file.close();
        return false;
    }

    file.read(json, len);
    json[len] = '\0';
    file.close();

    DynamicJsonDocument doc(4096);
    DeserializationError err = deserializeJson(doc, json);
    free(json);
    if (err)
        return false;

    copyString(config.wifiSsid, doc["wifi"]["ssid"] | "", sizeof(config.wifiSsid));
    copyString(config.wifiPassword, doc["wifi"]["password"] | "", sizeof(config.wifiPassword));
    const char *scriptUrl = doc["web"]["script_url"] | "";
    if (scriptUrl[0] == '\0')
        scriptUrl = doc["web"]["manifest_url"] | "";
    copyString(config.scriptUrl, scriptUrl, sizeof(config.scriptUrl));
    copyString(config.syncToken, doc["web"]["sync_token"] | "", sizeof(config.syncToken));
    copyString(config.photoDir, doc["display"]["photo_dir"] | DEFAULT_PHOTO_DIR, sizeof(config.photoDir));
    config.shuffle = doc["display"]["shuffle"] | true;
    config.updateMinutes = doc["display"]["update_minutes"] | 60;
    config.syncEveryUpdates = doc["web"]["sync_every_updates"] | 24;
    if (config.syncEveryUpdates == 0)
        config.syncEveryUpdates = 1;
    config.lowBatteryVoltage = doc["power"]["low_battery_voltage"] | 3.45f;
    config.lastIndex = doc["state"]["last_index"] | 0;
    normalizePhotoDir();
    return true;
}

bool saveConfig()
{
    SdFat &sd = display.getSdFat();
    ensureStorage();

    DynamicJsonDocument doc(4096);
    doc["wifi"]["ssid"] = config.wifiSsid;
    doc["wifi"]["password"] = config.wifiPassword;
    doc["web"]["script_url"] = config.scriptUrl;
    doc["web"]["sync_token"] = config.syncToken;
    doc["web"]["sync_every_updates"] = config.syncEveryUpdates;
    doc["display"]["photo_dir"] = config.photoDir;
    doc["display"]["shuffle"] = config.shuffle;
    doc["display"]["update_minutes"] = config.updateMinutes;
    doc["power"]["low_battery_voltage"] = config.lowBatteryVoltage;
    doc["state"]["last_index"] = config.lastIndex;

    sd.remove(CONFIG_PATH);
    SdFile file;
    if (!file.open(CONFIG_PATH, O_WRONLY | O_CREAT | O_TRUNC))
        return false;
    serializeJsonPretty(doc, file);
    file.close();
    return true;
}

String htmlEscape(String value)
{
    value.replace("&", "&amp;");
    value.replace("\"", "&quot;");
    value.replace("'", "&#39;");
    value.replace("<", "&lt;");
    value.replace(">", "&gt;");
    return value;
}

String urlEncode(const String &value)
{
    const char hex[] = "0123456789ABCDEF";
    String encoded;
    for (size_t i = 0; i < value.length(); ++i)
    {
        uint8_t c = value[i];
        if (isalnum(c) || c == '-' || c == '_' || c == '.' || c == '~')
        {
            encoded += (char)c;
        }
        else
        {
            encoded += '%';
            encoded += hex[c >> 4];
            encoded += hex[c & 0x0F];
        }
    }
    return encoded;
}

String buildScriptUrl(const char *mode, const String &id = "")
{
    String url = config.scriptUrl;
    url.trim();
    if (url.length() == 0)
        return "";

    if (url.indexOf('?') < 0)
        url += "?";
    else if (!url.endsWith("?") && !url.endsWith("&"))
        url += "&";

    url += "mode=";
    url += mode;
    url += "&token=";
    String token = config.syncToken;
    token.trim();
    url += urlEncode(token);
    if (id.length())
    {
        url += "&id=";
        url += urlEncode(id);
    }
    return url;
}

String joinPath(const char *dir, const String &name)
{
    String path(dir);
    if (!path.endsWith("/"))
        path += "/";
    path += name;
    return path;
}

bool copySdFile(const String &fromPath, const String &toPath, uint32_t &copiedBytes)
{
    copiedBytes = 0;
    SdFat &sd = display.getSdFat();
    SdFile in;
    if (!in.open(fromPath.c_str(), O_RDONLY))
        return false;

    SdFile out;
    sd.remove(toPath.c_str());
    if (!out.open(toPath.c_str(), O_WRONLY | O_CREAT | O_TRUNC))
    {
        in.close();
        return false;
    }

    uint8_t buffer[2048];
    bool ok = true;
    while (in.available())
    {
        int got = in.read(buffer, sizeof(buffer));
        if (got <= 0)
        {
            ok = false;
            break;
        }
        if (out.write(buffer, got) != (size_t)got)
        {
            ok = false;
            break;
        }
        copiedBytes += got;
        serviceWebServerDuringLongTask();
    }

    out.close();
    in.close();
    if (!ok)
        sd.remove(toPath.c_str());
    return ok;
}

String photoRoot()
{
    String root = config.photoDir;
    root.trim();
    while (root.length() > 1 && root.endsWith("/"))
        root.remove(root.length() - 1);
    return root;
}

bool hasSupportedExtension(String name)
{
    name.toLowerCase();
    return name.endsWith(".bin") || name.endsWith(".jpg") || name.endsWith(".jpeg") || name.endsWith(".png") ||
           name.endsWith(".bmp");
}

String sanitizeFilename(String name, uint16_t fallbackIndex)
{
    int query = name.indexOf('?');
    if (query >= 0)
        name.remove(query);
    int slash = name.lastIndexOf('/');
    if (slash >= 0)
        name = name.substring(slash + 1);
    name.trim();

    if (name.length() == 0 || !hasSupportedExtension(name))
        name = "photo_" + String(fallbackIndex) + ".jpg";

    String out;
    for (size_t i = 0; i < name.length() && out.length() < 60; ++i)
    {
        char c = name[i];
        if (isalnum(c) || c == '.' || c == '_' || c == '-')
            out += c;
        else
            out += '_';
    }
    return out;
}

String sanitizePathSegment(String segment)
{
    segment.trim();
    if (segment == "." || segment == "..")
        return "";

    String out;
    for (size_t i = 0; i < segment.length() && out.length() < 60; ++i)
    {
        char c = segment[i];
        if (isalnum(c) || c == '.' || c == '_' || c == '-' || c == ' ' || c == '(' || c == ')')
            out += c;
        else
            out += '_';
    }
    out.trim();
    return out;
}

String normalizeManagedPath(String input, bool allowRoot)
{
    String root = photoRoot();
    String raw = input;
    raw.replace('\\', '/');
    raw.trim();
    if (raw.length() == 0)
        raw = root;

    String rel;
    if (raw == root)
    {
        rel = "";
    }
    else if (raw.startsWith(root + "/"))
    {
        rel = raw.substring(root.length() + 1);
    }
    else
    {
        while (raw.startsWith("/"))
            raw.remove(0, 1);
        rel = raw;
    }

    String out = root;
    while (rel.length())
    {
        int slash = rel.indexOf('/');
        String segment = slash >= 0 ? rel.substring(0, slash) : rel;
        rel = slash >= 0 ? rel.substring(slash + 1) : "";

        segment.trim();
        if (segment.length() == 0 || segment == ".")
            continue;
        if (segment == "..")
            return "";

        String safe = sanitizePathSegment(segment);
        if (safe.length() == 0)
            return "";
        out += "/";
        out += safe;
    }

    if (!allowRoot && out == root)
        return "";
    return out;
}

String sanitizeUploadFilename(String filename)
{
    filename.replace('\\', '/');
    int slash = filename.lastIndexOf('/');
    if (slash >= 0)
        filename = filename.substring(slash + 1);
    int query = filename.indexOf('?');
    if (query >= 0)
        filename.remove(query);
    filename.trim();

    if (!hasSupportedExtension(filename))
        return "";

    String safe = sanitizePathSegment(filename);
    if (!hasSupportedExtension(safe))
        return "";
    return safe;
}

void setUiRotation()
{
    display.setRotation(PHOTO_ROTATION_LANDSCAPE);
}

void showStatus(const String &title, const String &line1 = "", const String &line2 = "", const String &line3 = "")
{
    setUiRotation();
    display.clearDisplay();
    display.setTextColor(INKPLATE_BLACK);
    display.setTextSize(4);
    display.setCursor(40, 60);
    display.println(title);
    display.setTextSize(2);
    display.setCursor(40, 150);
    if (line1.length())
        display.println(line1);
    if (line2.length())
        display.println(line2);
    if (line3.length())
        display.println(line3);
    display.display();
}

bool usbPowerDetected()
{
#if USB_POWER_DETECT_PIN >= 0
    pinMode(USB_POWER_DETECT_PIN, INPUT);
    return digitalRead(USB_POWER_DETECT_PIN) == USB_POWER_ACTIVE_LEVEL;
#elif defined(ARDUINO_USB_CDC_ON_BOOT) && ARDUINO_USB_CDC_ON_BOOT
    uint32_t start = millis();
    while (millis() - start < 2500)
    {
        if (Serial)
            return true;
        delay(10);
    }
#endif
    return false;
}

bool wakeButtonPressed()
{
    pinMode(WAKE_BUTTON_PIN, INPUT);
    return digitalRead(WAKE_BUTTON_PIN) == WAKE_BUTTON_ACTIVE_LEVEL;
}

bool wakeButtonRequestedConfig()
{
    return esp_sleep_get_wakeup_cause() == ESP_SLEEP_WAKEUP_EXT0 || wakeButtonPressed();
}

bool connectWiFi(uint32_t timeoutMs)
{
    if (strlen(config.wifiSsid) == 0)
        return false;
    if (WiFi.status() == WL_CONNECTED)
        return true;

    WiFi.mode(configModeRunning && configApRunning ? WIFI_AP_STA : WIFI_STA);
    WiFi.begin(config.wifiSsid, config.wifiPassword);

    uint32_t start = millis();
    while (WiFi.status() != WL_CONNECTED && millis() - start < timeoutMs)
        delay(250);
    return WiFi.status() == WL_CONNECTED;
}

bool reconnectConfigWiFi(uint32_t timeoutMs)
{
    if (strlen(config.wifiSsid) == 0)
        return false;

    WiFi.disconnect(false);
    delay(100);
    WiFi.mode(configApRunning ? WIFI_AP_STA : WIFI_STA);
    WiFi.begin(config.wifiSsid, config.wifiPassword);

    uint32_t start = millis();
    while (WiFi.status() != WL_CONNECTED && millis() - start < timeoutMs)
        delay(250);
    return WiFi.status() == WL_CONNECTED;
}

void startConfigAp()
{
    if (configApRunning)
        return;

    WiFi.mode(strlen(config.wifiSsid) > 0 ? WIFI_AP_STA : WIFI_AP);
    WiFi.softAP(AP_SSID, AP_PASSWORD);
    configApRunning = true;
}

void stopConfigAp()
{
    if (!configApRunning)
        return;

    WiFi.softAPdisconnect(true);
    configApRunning = false;
    WiFi.mode(WiFi.status() == WL_CONNECTED ? WIFI_STA : WIFI_OFF);
}

bool refreshConfigNetwork(uint32_t timeoutMs)
{
    bool wifiConnected = reconnectConfigWiFi(timeoutMs);
    if (wifiConnected)
        stopConfigAp();
    else
        startConfigAp();
    return wifiConnected;
}

void showConfigStatus()
{
    String line1;
    String line2;
    String line3 = "WAKE exits config mode";

    if (WiFi.status() == WL_CONNECTED)
    {
        line1 = String("Web UI: http://") + WiFi.localIP().toString();
        line2 = configApRunning ? String("AP fallback: http://") + WiFi.softAPIP().toString() :
                                  "AP disabled: home WiFi active";
    }
    else if (configApRunning)
    {
        line1 = String("AP: ") + AP_SSID + " / " + AP_PASSWORD;
        line2 = String("Web UI: http://") + WiFi.softAPIP().toString();
    }
    else if (strlen(config.wifiSsid) > 0)
    {
        line1 = String("WiFi not connected: ") + config.wifiSsid;
        line2 = "Starting fallback AP...";
    }
    else
    {
        line1 = "WiFi not configured";
        line2 = "Starting fallback AP...";
    }

    showStatus("Config mode", line1, line2, line3);
}

void scanPhotosInDir(const String &dirPath, uint8_t depth)
{
    if (photoCount >= MAX_PHOTOS || depth > 5)
        return;

    SdFile dir;
    if (!dir.open(dirPath.c_str(), O_RDONLY) || !dir.isDir())
    {
        dir.close();
        return;
    }

    SdFile entry;
    while (photoCount < MAX_PHOTOS && entry.openNext(&dir, O_RDONLY))
    {
        char name[96];
        if (!entry.getName(name, sizeof(name)))
        {
            entry.close();
            continue;
        }

        String childPath = joinPath(dirPath.c_str(), String(name));
        bool isDirectory = entry.isDir();
        if (!isDirectory && hasSupportedExtension(String(name)))
            photoList[photoCount++] = childPath;
        entry.close();

        if (isDirectory)
            scanPhotosInDir(childPath, depth + 1);
    }
    dir.close();
}

uint16_t scanPhotos()
{
    photoCount = 0;
    scanPhotosInDir(photoRoot(), 0);
    return photoCount;
}

bool deleteManagedFile(const String &path)
{
    String managed = normalizeManagedPath(path, false);
    if (managed.length() == 0 || !hasSupportedExtension(managed))
        return false;

    SdFile file;
    if (!file.open(managed.c_str(), O_RDONLY) || file.isDir())
    {
        file.close();
        return false;
    }
    file.close();
    return display.getSdFat().remove(managed.c_str());
}

bool createManagedFolder(const String &path)
{
    String managed = normalizeManagedPath(path, false);
    if (managed.length() == 0)
        return false;
    return display.getSdFat().mkdir(managed.c_str(), true);
}

bool deleteFolderRecursive(const String &path, uint8_t depth)
{
    if (depth > 8)
        return false;

    SdFat &sd = display.getSdFat();
    SdFile folder;
    if (!folder.open(path.c_str(), O_RDONLY) || !folder.isDir())
    {
        folder.close();
        return false;
    }

    SdFile entry;
    while (entry.openNext(&folder, O_RDONLY))
    {
        char name[96];
        if (!entry.getName(name, sizeof(name)))
        {
            entry.close();
            folder.close();
            return false;
        }

        String childPath = joinPath(path.c_str(), String(name));
        bool isDirectory = entry.isDir();
        entry.close();

        if (isDirectory)
        {
            if (!deleteFolderRecursive(childPath, depth + 1))
            {
                folder.close();
                return false;
            }
        }
        else if (!sd.remove(childPath.c_str()))
        {
            folder.close();
            return false;
        }
    }

    folder.close();
    return sd.rmdir(path.c_str());
}

bool deleteManagedFolder(const String &path)
{
    String managed = normalizeManagedPath(path, false);
    if (managed.length() == 0)
        return false;

    return deleteFolderRecursive(managed, 0);
}

void appendFileManagerRows(String &html, const String &dirPath, uint8_t depth, uint16_t &rows)
{
    if (rows >= 200 || depth > 5)
        return;

    SdFile dir;
    if (!dir.open(dirPath.c_str(), O_RDONLY) || !dir.isDir())
    {
        dir.close();
        return;
    }

    SdFile entry;
    while (rows < 200 && entry.openNext(&dir, O_RDONLY))
    {
        char name[96];
        if (!entry.getName(name, sizeof(name)))
        {
            entry.close();
            continue;
        }

        String childPath = joinPath(dirPath.c_str(), String(name));
        String indent;
        for (uint8_t i = 0; i < depth; ++i)
            indent += "&nbsp;&nbsp;&nbsp;";

        html += "<tr><td>";
        html += indent;
        html += entry.isDir() ? "Folder " : "File ";
        html += htmlEscape(name);
        html += "</td><td>";
        if (entry.isDir())
        {
            html += "-";
        }
        else
        {
            html += String(entry.fileSize());
            html += " bytes";
        }
        html += "</td><td>";
        if (entry.isDir())
        {
            html += "<form method='POST' action='/delete_folder' onsubmit=\"return confirm('Delete folder and contents?')\">";
            html += "<input type='hidden' name='path' value='" + htmlEscape(childPath) + "'>";
            html += "<button type='submit'>Delete folder</button></form>";
        }
        else if (hasSupportedExtension(String(name)))
        {
            html += "<form method='POST' action='/delete_file' onsubmit=\"return confirm('Delete file?')\">";
            html += "<input type='hidden' name='path' value='" + htmlEscape(childPath) + "'>";
            html += "<button type='submit'>Delete file</button></form>";
        }
        html += "</td></tr>";
        rows++;

        bool isDirectory = entry.isDir();
        entry.close();
        if (isDirectory)
            appendFileManagerRows(html, childPath, depth + 1, rows);
    }

    dir.close();
}

bool setDimensions(ImageDimensions &dimensions, uint32_t width, uint32_t height)
{
    if (width == 0 || height == 0 || width > 65535UL || height > 65535UL)
        return false;

    dimensions.width = (uint16_t)width;
    dimensions.height = (uint16_t)height;
    dimensions.valid = true;
    return true;
}

bool readPngDimensions(const char *path, ImageDimensions &dimensions)
{
    SdFile file;
    if (!file.open(path, O_RDONLY))
        return false;

    uint8_t header[24];
    bool ok = file.read(header, sizeof(header)) == (int)sizeof(header);
    file.close();
    if (!ok)
        return false;

    static const uint8_t pngSignature[8] = {0x89, 'P', 'N', 'G', 0x0D, 0x0A, 0x1A, 0x0A};
    if (memcmp(header, pngSignature, sizeof(pngSignature)) != 0 || memcmp(header + 12, "IHDR", 4) != 0)
        return false;

    return setDimensions(dimensions, readBe32(header + 16), readBe32(header + 20));
}

bool readBmpDimensions(const char *path, ImageDimensions &dimensions)
{
    SdFile file;
    if (!file.open(path, O_RDONLY))
        return false;

    uint8_t header[26];
    bool ok = file.read(header, sizeof(header)) == (int)sizeof(header);
    file.close();
    if (!ok || header[0] != 'B' || header[1] != 'M')
        return false;

    int32_t width = (int32_t)readLe32(header + 18);
    int32_t height = (int32_t)readLe32(header + 22);
    if (width <= 0 || height == 0)
        return false;
    if (height < 0)
        height = -height;

    return setDimensions(dimensions, (uint32_t)width, (uint32_t)height);
}

bool jpegMarkerHasDimensions(uint8_t marker)
{
    return marker == 0xC0 || marker == 0xC1 || marker == 0xC2 || marker == 0xC3 || marker == 0xC5 ||
           marker == 0xC6 || marker == 0xC7 || marker == 0xC9 || marker == 0xCA || marker == 0xCB ||
           marker == 0xCD || marker == 0xCE || marker == 0xCF;
}

bool readJpegDimensions(const char *path, ImageDimensions &dimensions)
{
    SdFile file;
    if (!file.open(path, O_RDONLY))
        return false;

    uint8_t first;
    uint8_t second;
    if (!readByte(file, first) || !readByte(file, second) || first != 0xFF || second != 0xD8)
    {
        file.close();
        return false;
    }

    while (file.available())
    {
        uint8_t markerStart = 0;
        do
        {
            if (!readByte(file, markerStart))
            {
                file.close();
                return false;
            }
        } while (markerStart != 0xFF && file.available());

        uint8_t marker = 0;
        do
        {
            if (!readByte(file, marker))
            {
                file.close();
                return false;
            }
        } while (marker == 0xFF);

        if (marker == 0xD9 || marker == 0xDA)
            break;
        if (marker == 0x01 || (marker >= 0xD0 && marker <= 0xD7))
            continue;

        uint16_t segmentLength;
        if (!readBe16(file, segmentLength) || segmentLength < 2)
        {
            file.close();
            return false;
        }

        if (jpegMarkerHasDimensions(marker))
        {
            uint8_t precision;
            uint8_t sizeBytes[4];
            if (!readByte(file, precision) || file.read(sizeBytes, sizeof(sizeBytes)) != (int)sizeof(sizeBytes))
            {
                file.close();
                return false;
            }
            (void)precision;
            uint16_t height = readBe16(sizeBytes);
            uint16_t width = readBe16(sizeBytes + 2);
            file.close();
            return setDimensions(dimensions, width, height);
        }

        if (!file.seekCur((int32_t)segmentLength - 2))
        {
            file.close();
            return false;
        }
    }

    file.close();
    return false;
}

bool readBinDimensions(const char *path, ImageDimensions &dimensions)
{
    SdFile file;
    if (!file.open(path, O_RDONLY))
        return false;

    uint8_t header[32];
    bool ok = file.read(header, sizeof(header)) == (int)sizeof(header);
    file.close();
    if (!ok)
        return false;

    uint32_t expectedBytes = (uint32_t)E_INK_WIDTH * (uint32_t)E_INK_HEIGHT / 2;
    if (memcmp(header, BIN_MAGIC, sizeof(BIN_MAGIC)) != 0 || header[8] != 1 ||
        readLe16(header + 16) != E_INK_WIDTH || readLe16(header + 18) != E_INK_HEIGHT ||
        readLe32(header + 20) != expectedBytes)
    {
        return false;
    }

    return setDimensions(dimensions, readLe16(header + 12), readLe16(header + 14));
}

bool readImageDimensions(const char *path, const String &lowerPath, ImageDimensions &dimensions)
{
    dimensions.width = 0;
    dimensions.height = 0;
    dimensions.valid = false;

    if (lowerPath.endsWith(".jpg") || lowerPath.endsWith(".jpeg"))
        return readJpegDimensions(path, dimensions);
    if (lowerPath.endsWith(".png"))
        return readPngDimensions(path, dimensions);
    if (lowerPath.endsWith(".bmp"))
        return readBmpDimensions(path, dimensions);
    if (lowerPath.endsWith(".bin"))
        return readBinDimensions(path, dimensions);
    return false;
}

uint8_t photoRotationForDimensions(const ImageDimensions &dimensions)
{
    if (dimensions.valid && dimensions.height > dimensions.width)
        return PHOTO_ROTATION_PORTRAIT;
    return PHOTO_ROTATION_LANDSCAPE;
}

uint16_t logicalWidthForRotation(uint8_t rotation)
{
    return (rotation == PHOTO_ROTATION_LANDSCAPE || rotation == 3) ? E_INK_HEIGHT : E_INK_WIDTH;
}

uint16_t logicalHeightForRotation(uint8_t rotation)
{
    return (rotation == PHOTO_ROTATION_LANDSCAPE || rotation == 3) ? E_INK_WIDTH : E_INK_HEIGHT;
}

int16_t centeredOffset(uint16_t contentSize, uint16_t screenSize)
{
    return contentSize < screenSize ? (int16_t)((screenSize - contentSize) / 2) : 0;
}

void configureHttpClient(HTTPClient &http)
{
    http.setFollowRedirects(HTTPC_STRICT_FOLLOW_REDIRECTS);
    http.setConnectTimeout(HTTP_CONNECT_TIMEOUT_MS);
    http.setTimeout(HTTP_READ_TIMEOUT_MS);
    http.setReuse(false);
    http.collectHeaders(HTTP_DEBUG_HEADER_KEYS, sizeof(HTTP_DEBUG_HEADER_KEYS) / sizeof(HTTP_DEBUG_HEADER_KEYS[0]));
}

String httpStatusText(HTTPClient &http, int code)
{
    if (code < 0)
        return String(code) + " (" + http.errorToString(code) + ")";
    return String(code);
}

void addHttpHeaders(HTTPClient &http, const char *accept)
{
    http.addHeader("Accept", accept);
    http.addHeader("Accept-Encoding", "identity");
}

String compactPreview(String value, size_t maxLength)
{
    value.replace('\r', ' ');
    value.replace('\n', ' ');
    value.trim();
    if (value.length() > maxLength)
        value = value.substring(0, maxLength) + "...";
    return value;
}

void serviceWebServerDuringLongTask()
{
    if (!configModeRunning)
        return;
    if (millis() - lastLongTaskWebService < 25)
        return;

    server.handleClient();
    lastLongTaskWebService = millis();
}

bool drawBinFromSd(const char *path)
{
    SdFile file;
    if (!file.open(path, O_RDONLY))
        return false;

    uint8_t header[32];
    if (file.read(header, sizeof(header)) != (int)sizeof(header))
    {
        file.close();
        return false;
    }

    const uint32_t expectedBytes = (uint32_t)E_INK_WIDTH * (uint32_t)E_INK_HEIGHT / 2;
    bool ok = memcmp(header, BIN_MAGIC, sizeof(BIN_MAGIC)) == 0 && header[8] == 1 && readLe16(header + 16) == E_INK_WIDTH &&
              readLe16(header + 18) == E_INK_HEIGHT && readLe32(header + 20) == expectedBytes;

    if (!ok)
    {
        file.close();
        return false;
    }

    uint32_t copied = 0;
    uint8_t chunk[2048];
    while (copied < expectedBytes)
    {
        size_t toRead = expectedBytes - copied;
        if (toRead > sizeof(chunk))
            toRead = sizeof(chunk);
        int got = file.read(chunk, toRead);
        if (got <= 0)
        {
            file.close();
            return false;
        }
        memcpy(display.DMemory4Bit + copied, chunk, got);
        copied += got;
    }

    file.close();
    return true;
}

bool drawCommonImageFromSd(const char *path, const ImageDimensions &dimensions, uint8_t rotation)
{
    String lower(path);
    lower.toLowerCase();
    int16_t x = 0;
    int16_t y = 0;
    if (dimensions.valid)
    {
        x = centeredOffset(dimensions.width, logicalWidthForRotation(rotation));
        y = centeredOffset(dimensions.height, logicalHeightForRotation(rotation));
    }

    if (lower.endsWith(".jpg") || lower.endsWith(".jpeg"))
        return display.image.draw(path, ImageColor::JPG, x, y, true, false);
    if (lower.endsWith(".png"))
        return display.image.draw(path, ImageColor::PNG, x, y, true, false);
    if (lower.endsWith(".bmp"))
        return display.image.draw(path, ImageColor::BMP, x, y, true, false);
    return false;
}

bool displayPhoto(const String &path)
{
    Serial.print("Displaying ");
    Serial.println(path);

    bool ok = false;
    String lower(path);
    lower.toLowerCase();
    ImageDimensions dimensions;
    readImageDimensions(path.c_str(), lower, dimensions);
    uint8_t rotation = photoRotationForDimensions(dimensions);
    display.setRotation(rotation);

    display.clearDisplay();
    if (lower.endsWith(".bin"))
        ok = drawBinFromSd(path.c_str());
    else
        ok = drawCommonImageFromSd(path.c_str(), dimensions, rotation);

    if (ok)
        display.display();
    setUiRotation();
    return ok;
}

bool downloadFile(const String &url, const String &path)
{
    debugLog("Download direct start: " + path + " from " + redactUrlToken(url));
    HTTPClient http;
    configureHttpClient(http);
    if (!http.begin(url))
    {
        debugLog("Download direct begin failed");
        return false;
    }

    addHttpHeaders(http, "*/*");
    int code = http.GET();
    debugLog("Download direct HTTP " + httpStatusText(http, code) + ", type=" + http.header("Content-Type") +
             ", transfer=" + http.header("Transfer-Encoding") + ", size=" + String(http.getSize()));
    if (code != HTTP_CODE_OK)
    {
        Serial.printf("Download HTTP %s: %s\n", httpStatusText(http, code).c_str(), url.c_str());
        http.end();
        return false;
    }

    String tmpPath = path + ".tmp";
    SdFat &sd = display.getSdFat();
    sd.remove(tmpPath.c_str());

    SdFile out;
    if (!out.open(tmpPath.c_str(), O_WRONLY | O_CREAT | O_TRUNC))
    {
        debugLog("Download direct SD open failed: " + tmpPath);
        http.end();
        return false;
    }

    WiFiClient *stream = http.getStreamPtr();
    int32_t remaining = http.getSize();
    uint8_t buffer[2048];
    uint32_t lastData = millis();
    bool ok = true;

    while ((http.connected() || stream->available()) && (remaining > 0 || remaining == -1))
    {
        size_t available = stream->available();
        if (available)
        {
            size_t toRead = available > sizeof(buffer) ? sizeof(buffer) : available;
            int got = stream->readBytes(buffer, toRead);
            if (got > 0)
            {
                out.write(buffer, got);
                if (remaining > 0)
                    remaining -= got;
                lastData = millis();
                serviceWebServerDuringLongTask();
            }
        }
        else
        {
            if (millis() - lastData > DOWNLOAD_IDLE_TIMEOUT_MS)
            {
                debugLog("Download direct idle timeout: " + path);
                ok = false;
                break;
            }
            serviceWebServerDuringLongTask();
            delay(2);
        }
    }

    out.close();
    http.end();

    if (!ok || remaining > 0)
    {
        debugLog("Download direct failed: " + path + ", remaining=" + String(remaining));
        sd.remove(tmpPath.c_str());
        return false;
    }

    sd.remove(path.c_str());
    bool renamed = sd.rename(tmpPath.c_str(), path.c_str());
    debugLog(String("Download direct ") + (renamed ? "saved: " : "rename failed: ") + path);
    return renamed;
}

int8_t base64Value(char c)
{
    if (c >= 'A' && c <= 'Z')
        return c - 'A';
    if (c >= 'a' && c <= 'z')
        return c - 'a' + 26;
    if (c >= '0' && c <= '9')
        return c - '0' + 52;
    if (c == '+')
        return 62;
    if (c == '/')
        return 63;
    if (c == '=')
        return 64;
    if (c == '\r' || c == '\n' || c == ' ' || c == '\t')
        return -2;
    return -1;
}

bool writeBase64Char(SdFile &out, char c, uint8_t quartet[4], uint8_t &quartetLen, uint32_t &decodedBytes)
{
    int8_t value = base64Value(c);
    if (value == -2)
        return true;
    if (value < 0)
        return false;

    quartet[quartetLen++] = value;
    if (quartetLen < 4)
        return true;

    if (quartet[0] == 64 || quartet[1] == 64 || (quartet[2] == 64 && quartet[3] != 64))
    {
        quartetLen = 0;
        return false;
    }

    uint8_t decoded[3];
    decoded[0] = (quartet[0] << 2) | (quartet[1] >> 4);
    decoded[1] = ((quartet[1] & 0x0F) << 4) | (quartet[2] >> 2);
    decoded[2] = ((quartet[2] & 0x03) << 6) | quartet[3];

    uint8_t count = 3;
    if (quartet[2] == 64)
        count = 1;
    else if (quartet[3] == 64)
        count = 2;

    if (out.write(decoded, count) != count)
    {
        quartetLen = 0;
        return false;
    }
    decodedBytes += count;
    quartetLen = 0;
    return true;
}

class Base64SdDecodeStream : public Stream
{
  public:
    explicit Base64SdDecodeStream(SdFile &outFile) : out(outFile)
    {
    }

    size_t write(uint8_t value) override
    {
        return write(&value, 1);
    }

    size_t write(const uint8_t *buffer, size_t size) override
    {
        if (failed)
        {
            setWriteError();
            return 0;
        }

        for (size_t i = 0; i < size; ++i)
        {
            if (responsePreview.length() < 96)
            {
                char previewChar = (char)buffer[i];
                responsePreview += (previewChar >= 32 && previewChar <= 126) ? previewChar : '.';
            }
            if (base64Value((char)buffer[i]) >= 0)
                base64Chars++;

            if (!writeBase64Char(out, (char)buffer[i], quartet, quartetLen, decodedBytes))
            {
                inputBytes += i;
                failed = true;
                errorMessage = "Download Apps Script base64/write failed at body byte " + String(inputBytes) +
                               ", char=" + String(buffer[i]) + ", preview=" + compactPreview(responsePreview, 96);
                setWriteError();
                return i;
            }
        }

        inputBytes += size;
        serviceWebServerDuringLongTask();
        return size;
    }

    int available() override
    {
        return 0;
    }

    int read() override
    {
        return -1;
    }

    int peek() override
    {
        return -1;
    }

    void flush() override
    {
        out.sync();
    }

    bool finish(uint32_t expectedSize)
    {
        if (quartetLen == 0)
            return !failed;

        String stats = statsString(expectedSize);
        if (expectedSize > 0 && decodedBytes == expectedSize)
        {
            debugLog("Download Apps Script ignored trailing incomplete base64 quartet" + stats);
            quartetLen = 0;
            return !failed;
        }

        errorMessage = "Download Apps Script base64 ended mid-quartet" + stats;
        if (expectedSize > 0 && decodedBytes < expectedSize)
            errorMessage += ". Response is shorter than the Drive file; check the Apps Script token/deployment.";
        failed = true;
        setWriteError();
        return false;
    }

    String statsString(uint32_t expectedSize) const
    {
        return ", inputBytes=" + String(inputBytes) + ", base64Chars=" + String(base64Chars) +
               ", quartetLen=" + String(quartetLen) + ", decodedBytes=" + String(decodedBytes) +
               ", expected=" + String(expectedSize) + ", preview=" + compactPreview(responsePreview, 96);
    }

    uint32_t inputSize() const
    {
        return inputBytes;
    }

    uint32_t base64CharCount() const
    {
        return base64Chars;
    }

    uint32_t decodedSize() const
    {
        return decodedBytes;
    }

    const String &error() const
    {
        return errorMessage;
    }

  private:
    SdFile &out;
    uint8_t quartet[4] = {0};
    uint8_t quartetLen = 0;
    uint32_t inputBytes = 0;
    uint32_t base64Chars = 0;
    uint32_t decodedBytes = 0;
    String responsePreview;
    String errorMessage;
    bool failed = false;
};

bool downloadBase64File(const String &url, const String &path, uint32_t expectedSize, uint32_t &decodedSize)
{
    decodedSize = 0;
    lastDownloadError = "";
    debugLog("Download Apps Script start: " + path + ", expected=" + String(expectedSize) + " from " +
             redactUrlToken(url));
    HTTPClient http;
    configureHttpClient(http);
    if (!http.begin(url))
    {
        setDownloadError("Download Apps Script begin failed");
        return false;
    }

    addHttpHeaders(http, "text/plain");
    int code = http.GET();
    String contentType = http.header("Content-Type");
    String transferEncoding = http.header("Transfer-Encoding");
    debugLog("Download Apps Script HTTP " + httpStatusText(http, code) + ", type=" + contentType +
             ", transfer=" + transferEncoding + ", size=" + String(http.getSize()));
    if (code != HTTP_CODE_OK)
    {
        setDownloadError("Download Apps Script HTTP failed: " + httpStatusText(http, code));
        Serial.printf("Base64 download HTTP %s\n", httpStatusText(http, code).c_str());
        http.end();
        return false;
    }

    String lowerContentType = contentType;
    lowerContentType.toLowerCase();
    if (lowerContentType.indexOf("json") >= 0 || lowerContentType.indexOf("html") >= 0)
    {
        String response = http.getString();
        setDownloadError("Download Apps Script returned non-base64 response: " + compactPreview(response, 220));
        http.end();
        return false;
    }

    String tmpPath = path + ".tmp";
    SdFat &sd = display.getSdFat();
    sd.remove(tmpPath.c_str());

    SdFile out;
    if (!out.open(tmpPath.c_str(), O_WRONLY | O_CREAT | O_TRUNC))
    {
        setDownloadError("Download Apps Script SD open failed: " + tmpPath);
        http.end();
        return false;
    }

    Base64SdDecodeStream decoder(out);
    int bodyBytes = http.writeToStream(&decoder);
    bool ok = decoder.finish(expectedSize);

    out.close();
    http.end();
    uint32_t decodedBytes = decoder.decodedSize();
    decodedSize = decodedBytes;
    debugLog("Download Apps Script stream done: bodyBytes=" + String(bodyBytes) +
             ", inputBytes=" + String(decoder.inputSize()) + ", base64Chars=" + String(decoder.base64CharCount()) +
             ", decodedBytes=" + String(decodedBytes));

    if (bodyBytes < 0)
    {
        if (decoder.error().length())
            setDownloadError(decoder.error() + ", path=" + path);
        else
            setDownloadError("Download Apps Script stream failed: " + httpStatusText(http, bodyBytes) +
                             ", path=" + path);
        ok = false;
    }
    else if (!ok && decoder.error().length())
    {
        setDownloadError(decoder.error() + ", path=" + path);
    }

    if (!ok)
    {
        if (lastDownloadError.length() == 0)
            setDownloadError("Download Apps Script failed: " + path);
        sd.remove(tmpPath.c_str());
        return false;
    }
    if (expectedSize > 0 && decodedBytes != expectedSize)
    {
        debugLog("Download Apps Script decoded size differs from Drive metadata: expected=" + String(expectedSize) +
                 ", decoded=" + String(decodedBytes) + ". Keeping decoded file.");
    }

    sd.remove(path.c_str());
    bool renamed = sd.rename(tmpPath.c_str(), path.c_str());
    if (!renamed)
    {
        uint32_t tmpSize = 0;
        SdFile tmpInfo;
        if (tmpInfo.open(tmpPath.c_str(), O_RDONLY))
        {
            tmpSize = tmpInfo.fileSize();
            tmpInfo.close();
        }
        debugLog("Download Apps Script rename failed, trying copy fallback: " + tmpPath + " -> " + path +
                 ", tmpSize=" + String(tmpSize));
        uint32_t copiedBytes = 0;
        bool copied = copySdFile(tmpPath, path, copiedBytes);
        if (copied && copiedBytes == decodedBytes)
        {
            sd.remove(tmpPath.c_str());
            debugLog("Download Apps Script saved with copy fallback: " + path + ", copied=" + String(copiedBytes));
            return true;
        }

        sd.remove(path.c_str());
        setDownloadError("Download Apps Script rename/copy failed: " + tmpPath + " -> " + path +
                         ", tmpSize=" + String(tmpSize) + ", copied=" + String(copiedBytes) +
                         ", decoded=" + String(decodedBytes));
    }
    else
    {
        debugLog("Download Apps Script saved: " + path);
    }
    return renamed;
}

void loadSyncState(DynamicJsonDocument &stateDoc)
{
    SdFile file;
    if (file.open(SYNC_STATE_PATH, O_RDONLY))
    {
        DeserializationError err = deserializeJson(stateDoc, file);
        file.close();
        if (!err && stateDoc["photos"].is<JsonArray>())
            return;
    }

    stateDoc.clear();
    stateDoc.createNestedArray("photos");
}

bool saveSyncState(DynamicJsonDocument &stateDoc)
{
    SdFat &sd = display.getSdFat();
    sd.remove(SYNC_STATE_PATH);
    SdFile file;
    if (!file.open(SYNC_STATE_PATH, O_WRONLY | O_CREAT | O_TRUNC))
        return false;
    serializeJsonPretty(stateDoc, file);
    file.close();
    return true;
}

JsonObject findStateEntry(JsonArray statePhotos, const String &id)
{
    for (JsonVariant value : statePhotos)
    {
        JsonObject entry = value.as<JsonObject>();
        if (String(entry["id"] | "") == id)
            return entry;
    }
    return JsonObject();
}

bool localFileSize(const String &path, uint32_t &actualSize)
{
    SdFile file;
    if (!file.open(path.c_str(), O_RDONLY))
        return false;
    actualSize = file.fileSize();
    file.close();
    return true;
}

bool localFileMatches(const String &path, uint32_t expectedSize)
{
    uint32_t actualSize = 0;
    if (!localFileSize(path, actualSize))
        return false;
    return actualSize == expectedSize;
}

bool stateMatches(JsonObject state, const String &name, const String &modified, uint32_t size)
{
    if (state.isNull())
        return false;
    return String(state["name"] | "") == name && String(state["modified"] | "") == modified &&
           ((uint32_t)(state["size"] | 0)) == size;
}

uint32_t stateLocalSize(JsonObject state, uint32_t fallbackSize)
{
    if (state.isNull())
        return fallbackSize;
    uint32_t localSize = state["local_size"] | 0;
    return localSize > 0 ? localSize : fallbackSize;
}

void recordSyncState(JsonArray statePhotos, const String &id, const String &name, const String &modified, uint32_t size,
                     uint32_t localSize)
{
    JsonObject item = statePhotos.createNestedObject();
    item["id"] = id;
    item["name"] = name;
    item["modified"] = modified;
    item["size"] = size;
    item["local_size"] = localSize;
}

String filenameFromUrl(const String &url, uint16_t index)
{
    return sanitizeFilename(url, index);
}

uint16_t syncFromDriveFolder()
{
    debugLog(String("Sync start build=") + FRAME_BUILD_ID);
    lastDownloadError = "";
    if (strlen(config.scriptUrl) == 0)
    {
        lastWebMessage = "No Apps Script URL configured.";
        debugLog(lastWebMessage);
        return 0;
    }
    if (strlen(config.syncToken) == 0)
    {
        lastWebMessage = "No sync token configured.";
        debugLog(lastWebMessage);
        return 0;
    }
    if (!connectWiFi(WIFI_TIMEOUT_MS))
    {
        lastWebMessage = "WiFi connection failed.";
        debugLog(lastWebMessage);
        return 0;
    }
    debugLog("WiFi connected: ip=" + WiFi.localIP().toString() + ", rssi=" + String(WiFi.RSSI()) +
             ", ssid=" + String(config.wifiSsid));

    HTTPClient http;
    configureHttpClient(http);
    String requestUrl = buildScriptUrl("manifest");
    debugLog("Manifest URL: " + redactUrlToken(requestUrl));
    if (!http.begin(requestUrl))
    {
        lastWebMessage = "Could not open Apps Script URL.";
        debugLog(lastWebMessage);
        return 0;
    }

    addHttpHeaders(http, "application/json");
    int code = http.GET();
    debugLog("Manifest HTTP " + httpStatusText(http, code) + ", type=" + http.header("Content-Type") +
             ", transfer=" + http.header("Transfer-Encoding") + ", contentLength=" + http.header("Content-Length") +
             ", getSize=" + String(http.getSize()));
    if (code != HTTP_CODE_OK)
    {
        lastWebMessage = "Manifest HTTP error " + httpStatusText(http, code);
        debugLog(lastWebMessage + ", location=" + http.header("Location"));
        http.end();
        return 0;
    }

    String manifestBody = http.getString();
    http.end();
    writeTextFile(MANIFEST_RESPONSE_PATH, manifestBody);
    debugLog("Manifest body bytes=" + String(manifestBody.length()));
    debugLog("Manifest body preview: " + compactPreview(manifestBody, 220));
    if (manifestBody.length() > MAX_MANIFEST_BODY_BYTES)
    {
        lastWebMessage = "Manifest too large: " + String(manifestBody.length()) + " bytes. Limit Drive folder to " +
                         String((uint16_t)MAX_MANIFEST_ITEMS) + " files.";
        debugLog(lastWebMessage);
        return 0;
    }

    DynamicJsonDocument doc(MANIFEST_JSON_CAPACITY);
    DeserializationError err = deserializeJson(doc, manifestBody);
    if (err)
    {
        lastWebMessage = String("Manifest JSON ") + err.c_str() + ": " + compactPreview(manifestBody, 96);
        debugLog(lastWebMessage);
        return 0;
    }
    debugLog("Manifest JSON parsed successfully");

    JsonArray photos;
    if (doc.is<JsonArray>())
        photos = doc.as<JsonArray>();
    else
        photos = doc["photos"].as<JsonArray>();

    if (photos.isNull())
    {
        lastWebMessage = "Manifest must be an array or contain photos[].";
        debugLog(lastWebMessage);
        return 0;
    }
    debugLog("Manifest photos count=" + String((uint32_t)photos.size()));

    ensureStorage();
    DynamicJsonDocument stateDoc(32768);
    DynamicJsonDocument newStateDoc(32768);
    loadSyncState(stateDoc);
    JsonArray oldState = stateDoc["photos"].as<JsonArray>();
    JsonArray newState = newStateDoc.createNestedArray("photos");

    uint16_t downloaded = 0;
    uint16_t skipped = 0;
    uint16_t failed = 0;
    uint16_t seen = 0;

    for (JsonVariant item : photos)
    {
        serviceWebServerDuringLongTask();
        if (seen >= MAX_MANIFEST_ITEMS)
        {
            debugLog("Manifest item cap reached: " + String((uint16_t)MAX_MANIFEST_ITEMS));
            break;
        }
        seen++;

        if (!item.is<JsonObject>())
        {
            debugLog("Manifest item " + String(seen) + " ignored: not an object");
            continue;
        }

        String id = item["id"] | "";
        String url;
        String name = item["name"] | "";
        String modified = item["modified"] | "";
        uint32_t remoteSize = item["size"] | 0;

        if (name.length() == 0)
            name = id.length() ? ("drive_" + id + ".jpg") : filenameFromUrl(url, seen);
        name = sanitizeFilename(name, seen);
        if (!hasSupportedExtension(name))
        {
            debugLog("Manifest item " + String(seen) + " ignored: unsupported name " + name);
            continue;
        }

        debugLog("Manifest item " + String(seen) + ": name=" + name + ", idLen=" + String(id.length()) +
                 ", size=" + String(remoteSize) + ", modified=" + modified);

        String target = joinPath(config.photoDir, name);
        JsonObject oldEntry = findStateEntry(oldState, id);
        uint32_t expectedLocalSize = stateLocalSize(oldEntry, remoteSize);
        bool unchanged = id.length() > 0 && expectedLocalSize > 0 && localFileMatches(target, expectedLocalSize) &&
                         stateMatches(oldEntry, name, modified, remoteSize);

        if (unchanged)
        {
            skipped++;
            debugLog("Skipped unchanged: " + target);
            recordSyncState(newState, id, name, modified, remoteSize, expectedLocalSize);
            continue;
        }

        bool ok = false;
        bool usedAppsScriptDownload = false;
        uint32_t savedSize = 0;
        url = item["url"] | "";
        if (url.length())
        {
            ok = downloadFile(url, target);
            if (ok)
                localFileSize(target, savedSize);
        }
        else if (id.length())
        {
            usedAppsScriptDownload = true;
            ok = downloadBase64File(buildScriptUrl("file", id), target, remoteSize, savedSize);
        }
        else
        {
            setDownloadError("Manifest item has no download URL or Drive id: " + name);
        }

        if (ok && remoteSize > 0 && !usedAppsScriptDownload && savedSize != remoteSize)
        {
            display.getSdFat().remove(target.c_str());
            setDownloadError("Downloaded size mismatch, removed: " + target + ", expected=" + String(remoteSize) +
                             ", actual=" + String(savedSize));
            ok = false;
        }

        if (ok)
        {
            if (savedSize == 0)
                localFileSize(target, savedSize);
            downloaded++;
            debugLog("Downloaded OK: " + target + ", localSize=" + String(savedSize) +
                     ", driveSize=" + String(remoteSize));
            recordSyncState(newState, id, name, modified, remoteSize, savedSize);
        }
        else
        {
            failed++;
            debugLog("Download failed: " + target +
                     (lastDownloadError.length() ? ", reason=" + lastDownloadError : ""));
        }
    }

    saveSyncState(newStateDoc);
    if (!configModeRunning)
        WiFi.mode(WIFI_OFF);
    lastWebMessage = "Downloaded " + String(downloaded) + ", skipped " + String(skipped) + ", failed " +
                     String(failed) + " of " + String(seen) + " Drive items.";
    if (failed > 0 && lastDownloadError.length())
        lastWebMessage += " Last error: " + lastDownloadError;
    debugLog("Sync done: " + lastWebMessage);
    return downloaded;
}

void sleepForMinutes(uint32_t minutes)
{
    if (minutes == 0)
        minutes = 1;
    display.sdCardSleep();
    WiFi.mode(WIFI_OFF);
    esp_sleep_enable_timer_wakeup((uint64_t)minutes * 60ULL * 1000000ULL);
    esp_sleep_enable_ext0_wakeup(WAKE_BUTTON_PIN, WAKE_BUTTON_ACTIVE_LEVEL);
    esp_deep_sleep_start();
}

void handleLowBattery(float voltage)
{
    showStatus("Battery low", "Please charge the Inkplate.", "Battery: " + String(voltage, 2) + " V");
    sleepForMinutes(360);
}

void runFrameMode()
{
    float voltage = display.readBattery();
    if (voltage > 1.0f && voltage < config.lowBatteryVoltage)
        handleLowBattery(voltage);

    if (!syncCounterInitialized)
    {
        updatesSinceLastSync = config.syncEveryUpdates;
        syncCounterInitialized = true;
    }
    else if (updatesSinceLastSync < UINT32_MAX)
    {
        updatesSinceLastSync++;
    }

    scanPhotos();
    bool syncConfigured = strlen(config.scriptUrl) > 0 && strlen(config.syncToken) > 0 && strlen(config.wifiSsid) > 0;
    bool shouldSync = syncConfigured && (photoCount == 0 || updatesSinceLastSync >= config.syncEveryUpdates);
    bool didSync = false;
    if (photoCount == 0 && shouldSync)
    {
        showStatus("No local photos", "Syncing from Drive...");
        syncInProgress = true;
        syncFromDriveFolder();
        syncInProgress = false;
        updatesSinceLastSync = 0;
        didSync = true;
        scanPhotos();
    }

    if (photoCount == 0)
    {
        showStatus("No photos found", String("Copy JPG, PNG, BMP, or BIN files to ") + config.photoDir,
                   "Or use USB/config mode to sync.");
        sleepForMinutes(config.updateMinutes);
    }

    randomSeed(micros());
    uint16_t start = config.shuffle ? random(photoCount) : (config.lastIndex % photoCount);
    bool shown = false;

    for (uint16_t attempt = 0; attempt < photoCount && !shown; ++attempt)
    {
        uint16_t index = (start + attempt) % photoCount;
        shown = displayPhoto(photoList[index]);
        if (shown && !config.shuffle)
        {
            config.lastIndex = (index + 1) % photoCount;
            saveConfig();
        }
    }

    if (!shown)
        showStatus("Image error", "No supported photos could be displayed.", config.photoDir);

    if (shown && shouldSync && !didSync)
    {
        syncInProgress = true;
        syncFromDriveFolder();
        syncInProgress = false;
        updatesSinceLastSync = 0;
    }

    sleepForMinutes(config.updateMinutes);
}

void handleIndex()
{
    String html = "<!doctype html><html><head><meta name='viewport' content='width=device-width,initial-scale=1'>";
    html += "<title>Inkplate 13 Picture Frame</title><style>";
    html += "body{font-family:Arial,sans-serif;max-width:760px;margin:24px auto;padding:0 16px;line-height:1.4}";
    html += "label{display:block;margin-top:12px;font-weight:600}input{width:100%;box-sizing:border-box;padding:8px}";
    html += "button{margin-top:16px;padding:10px 14px}.row{margin:14px 0;padding:12px;background:#f4f4f4}";
    html += "table{width:100%;border-collapse:collapse;margin-top:12px}td,th{border-bottom:1px solid #ddd;padding:6px;text-align:left}";
    html += "td form{margin:0}td button{margin:0;padding:6px 8px}";
    html += "</style></head><body><h1>Inkplate 13 Picture Frame</h1>";
    html += "<div class='row'>";
    if (WiFi.status() == WL_CONNECTED)
        html += "Home WiFi IP: " + WiFi.localIP().toString();
    else if (strlen(config.wifiSsid) > 0)
        html += "Home WiFi: not connected";
    else
        html += "Home WiFi: not configured";
    if (configApRunning)
    {
        html += "<br>Config AP: " + String(AP_SSID) + " / " + String(AP_PASSWORD);
        html += "<br>AP IP: " + WiFi.softAPIP().toString();
    }
    else
    {
        html += "<br>Config AP: disabled";
    }
    html += "<br>Sync: ";
    html += syncInProgress ? "running" : (configSyncPending ? "queued" : "idle");
    html += "<br>Photos found: " + String(scanPhotos()) + "<br>" + htmlEscape(lastWebMessage) + "</div>";
    html += "<h2>Debug</h2><div class='row'>";
    html += "<a href='/log'>sync_debug.log</a> | <a href='/manifest_response'>last_manifest_response.txt</a>";
    html += "<form method='POST' action='/clear_log'><button type='submit'>Clear log</button></form>";
    String debugPreview = readTextFileTail(DEBUG_LOG_PATH, WEB_DEBUG_PREVIEW_BYTES);
    if (debugPreview.length())
        html += "<pre style='white-space:pre-wrap;max-height:260px;overflow:auto'>" + htmlEscape(debugPreview) + "</pre>";
    else
        html += "No debug log yet.";
    html += "</div>";
    html += "<form method='POST' action='/save'>";
    html += "<label>WiFi SSID</label><input name='ssid' value='" + htmlEscape(config.wifiSsid) + "'>";
    html += "<label>WiFi password</label><input name='password' type='password' placeholder='Leave blank to keep current'>";
    html += "<label>Apps Script URL</label><input name='script_url' value='" + htmlEscape(config.scriptUrl) + "'>";
    html += "<label>Sync token</label><input name='sync_token' type='password' placeholder='Leave blank to keep current'>";
    html += "<label>Sync every display updates</label><input name='sync_every' type='number' min='1' value='" +
            String(config.syncEveryUpdates) + "'>";
    html += "<label>SD photo folder</label><input name='photo_dir' value='" + htmlEscape(config.photoDir) + "'>";
    html += "<label>Update interval, minutes</label><input name='interval' type='number' min='1' value='" +
            String(config.updateMinutes) + "'>";
    html += "<label>Low battery voltage</label><input name='low_battery' type='number' step='0.01' value='" +
            String(config.lowBatteryVoltage, 2) + "'>";
    html += "<label><input style='width:auto' name='shuffle' type='checkbox' ";
    if (config.shuffle)
        html += "checked";
    html += "> Shuffle photos</label><button type='submit'>Save settings</button></form>";
    html += "<form method='POST' action='/sync'><button type='submit'>Sync photos now</button></form>";
    html += "<form method='POST' action='/show'><button type='submit'>Show next local photo</button></form>";
    html += "<h2>Files</h2>";
    html += "<div class='row'>Photo root: " + htmlEscape(photoRoot()) + "</div>";
    html += "<form id='uploadForm' method='POST' action='/upload?folder=" + urlEncode(photoRoot()) +
            "' enctype='multipart/form-data' onsubmit=\"this.action='/upload?folder='+encodeURIComponent(document.getElementById('uploadFolder').value)\">";
    html += "<label>Upload folder</label><input id='uploadFolder' name='folder' value='" + htmlEscape(photoRoot()) + "'>";
    html += "<label>Image file</label><input type='file' name='image' accept='.bin,.jpg,.jpeg,.png,.bmp,image/jpeg,image/png,image/bmp'>";
    html += "<button type='submit'>Upload image</button></form>";
    html += "<form method='POST' action='/mkdir'>";
    html += "<label>New folder</label><input name='path' placeholder='Trips/2026'>";
    html += "<button type='submit'>Create folder</button></form>";
    html += "<table><tr><th>Name</th><th>Size</th><th>Action</th></tr>";
    uint16_t rows = 0;
    appendFileManagerRows(html, photoRoot(), 0, rows);
    if (rows == 0)
        html += "<tr><td colspan='3'>No files found</td></tr>";
    html += "</table>";
    html += "<form method='POST' action='/reboot'><button type='submit'>Reboot to frame mode</button></form>";
    html += "</body></html>";
    server.send(200, "text/html", html);
}

void redirectHome()
{
    server.sendHeader("Location", "/");
    server.send(303, "text/plain", "");
}

bool rejectIfSyncInProgress()
{
    if (!syncInProgress)
        return false;

    server.send(409, "text/plain", "Sync is in progress. Open /log for progress and try this command again later.");
    return true;
}

void handleTextFile(const char *path, const char *missingMessage)
{
    String body = readTextFileTail(path, MAX_DEBUG_LOG_BYTES);
    if (body.length() == 0)
        body = missingMessage;
    server.send(200, "text/plain", body);
}

void handleDebugLog()
{
    handleTextFile(DEBUG_LOG_PATH, "No debug log yet.\n");
}

void handleManifestResponse()
{
    handleTextFile(MANIFEST_RESPONSE_PATH, "No manifest response captured yet.\n");
}

void handleClearLog()
{
    if (rejectIfSyncInProgress())
        return;

    SdFat &sd = display.getSdFat();
    sd.remove(DEBUG_LOG_PATH);
    sd.remove(MANIFEST_RESPONSE_PATH);
    lastWebMessage = "Debug log cleared.";
    redirectHome();
}

void handleSave()
{
    if (rejectIfSyncInProgress())
        return;

    copyString(config.wifiSsid, server.arg("ssid").c_str(), sizeof(config.wifiSsid));
    if (server.arg("password").length() > 0)
        copyString(config.wifiPassword, server.arg("password").c_str(), sizeof(config.wifiPassword));
    copyString(config.scriptUrl, server.arg("script_url").c_str(), sizeof(config.scriptUrl));
    if (server.arg("sync_token").length() > 0)
        copyString(config.syncToken, server.arg("sync_token").c_str(), sizeof(config.syncToken));
    uint32_t syncEvery = max(1UL, (unsigned long)server.arg("sync_every").toInt());
    if (syncEvery > 65535UL)
        syncEvery = 65535UL;
    config.syncEveryUpdates = (uint16_t)syncEvery;
    copyString(config.photoDir, server.arg("photo_dir").c_str(), sizeof(config.photoDir));
    normalizePhotoDir();
    config.shuffle = server.hasArg("shuffle");
    config.updateMinutes = max(1UL, (unsigned long)server.arg("interval").toInt());
    config.lowBatteryVoltage = server.arg("low_battery").toFloat();
    if (config.lowBatteryVoltage < 3.0f || config.lowBatteryVoltage > 4.2f)
        config.lowBatteryVoltage = 3.45f;
    saveConfig();
    updatesSinceLastSync = config.syncEveryUpdates;
    syncCounterInitialized = true;
    display.getSdFat().remove(CONFIG_TRIGGER_PATH);
    configReconnectPending = true;
    configReconnectAt = millis() + 1500;
    lastWebMessage = "Settings saved. Reconnecting WiFi...";
    server.sendHeader("Location", "/");
    server.send(303, "text/plain", "");
}

void handleSync()
{
    if (syncInProgress || configSyncPending)
    {
        lastWebMessage = "Sync is already running.";
        redirectHome();
        return;
    }

    configSyncPending = true;
    lastWebMessage = "Sync queued. Open /log for progress.";
    redirectHome();
}

void handleShow()
{
    if (rejectIfSyncInProgress())
        return;

    scanPhotos();
    if (photoCount == 0)
        lastWebMessage = "No local photos to show.";
    else
    {
        uint16_t index = config.lastIndex % photoCount;
        lastWebMessage = displayPhoto(photoList[index]) ? "Displayed " + photoList[index] : "Display failed.";
        config.lastIndex = (index + 1) % photoCount;
        saveConfig();
    }
    server.sendHeader("Location", "/");
    server.send(303, "text/plain", "");
}

void handleCreateFolder()
{
    if (rejectIfSyncInProgress())
        return;

    String requestedPath = server.arg("path");
    if (createManagedFolder(requestedPath))
        lastWebMessage = "Folder created.";
    else
        lastWebMessage = "Folder create failed.";
    redirectHome();
}

void handleDeleteFile()
{
    if (rejectIfSyncInProgress())
        return;

    String requestedPath = server.arg("path");
    if (deleteManagedFile(requestedPath))
        lastWebMessage = "File deleted.";
    else
        lastWebMessage = "File delete failed.";
    scanPhotos();
    redirectHome();
}

void handleDeleteFolder()
{
    if (rejectIfSyncInProgress())
        return;

    String requestedPath = server.arg("path");
    if (deleteManagedFolder(requestedPath))
        lastWebMessage = "Folder deleted.";
    else
        lastWebMessage = "Folder delete failed.";
    scanPhotos();
    redirectHome();
}

void handleUploadComplete()
{
    if (rejectIfSyncInProgress())
        return;

    if (uploadResultMessage.length() == 0)
        uploadResultMessage = "No upload received.";
    lastWebMessage = uploadResultMessage;
    scanPhotos();
    redirectHome();
}

void handleUpload()
{
    if (syncInProgress)
        return;

    HTTPUpload &upload = server.upload();
    SdFat &sd = display.getSdFat();

    if (upload.status == UPLOAD_FILE_START)
    {
        uploadOk = false;
        uploadFinalPath = "";
        uploadTempPath = "";
        uploadResultMessage = "";

        String folder = normalizeManagedPath(server.arg("folder"), true);
        String filename = sanitizeUploadFilename(upload.filename);
        if (folder.length() == 0 || filename.length() == 0)
        {
            uploadResultMessage = "Upload rejected: unsupported file name.";
            return;
        }

        sd.mkdir(folder.c_str(), true);
        uploadFinalPath = joinPath(folder.c_str(), filename);
        uploadTempPath = uploadFinalPath + ".upload";
        sd.remove(uploadTempPath.c_str());

        uploadOk = uploadFile.open(uploadTempPath.c_str(), O_WRONLY | O_CREAT | O_TRUNC);
        if (!uploadOk)
            uploadResultMessage = "Upload failed: could not open file.";
    }
    else if (upload.status == UPLOAD_FILE_WRITE)
    {
        if (!uploadOk)
            return;

        size_t written = uploadFile.write(upload.buf, upload.currentSize);
        if (written != upload.currentSize)
        {
            uploadOk = false;
            uploadResultMessage = "Upload failed: SD write error.";
        }
    }
    else if (upload.status == UPLOAD_FILE_END)
    {
        if (uploadTempPath.length())
            uploadFile.close();
        if (uploadOk)
        {
            sd.remove(uploadFinalPath.c_str());
            if (sd.rename(uploadTempPath.c_str(), uploadFinalPath.c_str()))
                uploadResultMessage = "Uploaded " + uploadFinalPath;
            else
            {
                sd.remove(uploadTempPath.c_str());
                uploadResultMessage = "Upload failed: rename error.";
            }
        }
        else if (uploadTempPath.length())
        {
            sd.remove(uploadTempPath.c_str());
        }
    }
    else if (upload.status == UPLOAD_FILE_ABORTED)
    {
        if (uploadTempPath.length())
            uploadFile.close();
        if (uploadTempPath.length())
            sd.remove(uploadTempPath.c_str());
        uploadOk = false;
        uploadResultMessage = "Upload aborted.";
    }
}

void handleReboot()
{
    if (rejectIfSyncInProgress())
        return;

    display.getSdFat().remove(CONFIG_TRIGGER_PATH);
    server.send(200, "text/plain", "Rebooting...");
    delay(500);
    ESP.restart();
}

void runConfigMode()
{
    configModeRunning = true;
    bool wifiConnected = refreshConfigNetwork(12000);
    if (lastWebMessage.length() == 0)
    {
        lastWebMessage = wifiConnected ? "Serving config on home WiFi. Config AP disabled." :
                                         "Serving config on fallback AP.";
    }
    showConfigStatus();

    server.on("/", HTTP_GET, handleIndex);
    server.on("/log", HTTP_GET, handleDebugLog);
    server.on("/manifest_response", HTTP_GET, handleManifestResponse);
    server.on("/clear_log", HTTP_POST, handleClearLog);
    server.on("/save", HTTP_POST, handleSave);
    server.on("/sync", HTTP_POST, handleSync);
    server.on("/show", HTTP_POST, handleShow);
    server.on("/upload", HTTP_POST, handleUploadComplete, handleUpload);
    server.on("/mkdir", HTTP_POST, handleCreateFolder);
    server.on("/delete_file", HTTP_POST, handleDeleteFile);
    server.on("/delete_folder", HTTP_POST, handleDeleteFolder);
    server.on("/reboot", HTTP_POST, handleReboot);
    server.begin();

    bool lastRawButton = wakeButtonPressed();
    bool stableButton = lastRawButton;
    uint32_t lastButtonChange = millis();

    while (true)
    {
        server.handleClient();

        if (configSyncPending && !syncInProgress)
        {
            configSyncPending = false;
            syncInProgress = true;
            lastWebMessage = "Sync in progress. Open /log for details.";
            uint16_t count = syncFromDriveFolder();
            scanPhotos();
            syncInProgress = false;
            if (WiFi.status() != WL_CONNECTED && !configApRunning)
                startConfigAp();
            lastWebMessage += " Total local photos: " + String(photoCount) + ".";
            Serial.printf("Synced %u photos\n", count);
        }

        if (configReconnectPending && millis() - configReconnectAt < 0x80000000UL)
        {
            configReconnectPending = false;
            bool wifiConnected = refreshConfigNetwork(12000);
            lastWebMessage = wifiConnected ? String("Settings saved. WiFi connected at http://") +
                                                  WiFi.localIP().toString() + ". Config AP disabled." :
                                              "Settings saved. WiFi not connected. Config AP enabled.";
            showConfigStatus();
        }

        bool rawButton = wakeButtonPressed();
        if (rawButton != lastRawButton)
        {
            lastRawButton = rawButton;
            lastButtonChange = millis();
        }

        if (rawButton != stableButton && millis() - lastButtonChange >= WAKE_BUTTON_DEBOUNCE_MS)
        {
            stableButton = rawButton;
            if (stableButton)
            {
                display.getSdFat().remove(CONFIG_TRIGGER_PATH);
                lastWebMessage = "Config mode closed with WAKE button.";
                showStatus("Photo mode", "Web config closed.", "Returning to frame mode...");
                WiFi.softAPdisconnect(true);
                configApRunning = false;
                WiFi.disconnect(true);
                WiFi.mode(WIFI_OFF);
                configModeRunning = false;
                return;
            }
        }

        delay(10);
    }
}

void setup()
{
    Serial.begin(115200);
    display.begin();
    display.setTextColor(INKPLATE_BLACK);
    display.setTextSize(2);

    if (!display.sdCardInit())
    {
        showStatus("SD card error", "Insert a FAT-formatted SD card.");
        while (true)
            delay(1000);
    }

    bool hadConfig = loadConfig();
    ensureStorage();
    if (!hadConfig)
        saveConfig();

    bool forceConfig = display.getSdFat().exists(CONFIG_TRIGGER_PATH);
    if (!hadConfig || forceConfig || usbPowerDetected() || wakeButtonRequestedConfig())
        runConfigMode();

    runFrameMode();
}

void loop()
{
    // Not used. The frame wakes, performs one action, then enters deep sleep.
}
